## lib/bsp_guition/Kconfig
```kconfig
menu "MKAuto BSP GUITION"

    config MK_BSP_LCD_PANEL_NEW
        bool "Painel novo do JC1060P470C_I_W_Y"
        default y
        help
            O _I_W_Y sai de fabrica com um de dois paineis JD9165, cada um com
            sequencia de init e timings proprios. A unidade de referencia usa
            o painel novo (hsync 24/136/160, vsync 2/21/12, 60 comandos).
            Desligado: painel antigo (hsync 20/160/160, vsync 10/23/12).

    config MK_BSP_LCD_RST_GPIO
        int "GPIO de reset do LCD"
        range -1 54
        default 5
        help
            Validado como GPIO5 no _I_W_Y. O esquematico do _I_W cita GPIO27.

    config MK_BSP_LCD_TEST_PATTERN
        bool "Padrao de teste antes do LVGL (bring-up)"
        default n
        help
            Mostra 4 s de barras do gerador de hardware do DSI e 4 s de barras
            escritas no frame buffer. Isola enlace/init de DMA/frame buffer.

endmenu
```

## lib/telemetry_sim/Kconfig
```kconfig
menu "MKAuto telemetria simulada"

    config MK_TELEMETRY_SIM
        bool "Usar telemetria simulada"
        default y
        help
            Publica um ciclo de conducao sintetico no modelo de telemetria,
            para desenvolver a interface sem ELM/BLE (DEC-012). Desligar
            quando a fonte real do veiculo estiver integrada.

    config MK_TELEMETRY_SIM_DROPOUTS
        bool "Simular perdas de comunicacao"
        depends on MK_TELEMETRY_SIM
        default y
        help
            A cada 90 s para de publicar por 3 s, exercitando os estados
            STALE e indisponivel na interface.

endmenu
```

## src/Kconfig.projbuild
```kconfig
menu "MKAuto aplicacao"

    config MK_APP_BRINGUP_SCREEN
        bool "Tela tecnica do M0 em vez do dashboard"
        default n
        help
            Barras de cor, alvos de toque nos cantos e memoria livre, para
            revalidar display e touch da placa.

endmenu
```
